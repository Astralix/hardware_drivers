TOOLBAR ON
STATUSBAR ON

WINPAGE.RESET
WINCLEAR

WINPOS 85.0 0.0625 49. 16. 0. 0. W001
ws.Register /SpotLight

WINPOS 0.25 0.0625 94. 59. 13. 1. W000
WINTABS 10. 10. 25. 62.
ws.Data.List

WINPAGE.SELECT P000
