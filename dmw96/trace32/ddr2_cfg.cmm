; DDR2 200 MHz denali_setup
D.S A:0x00100000 %LE %LONG 0x00000400
D.S A:0x00100004 %LE %LONG 0x00000000
D.S A:0x00100008 %LE %LONG 0x00009c40
D.S A:0x0010000c %LE %LONG 0x00000000
D.S A:0x00100010 %LE %LONG 0x00000000
D.S A:0x00100014 %LE %LONG 0x00000000
D.S A:0x00100018 %LE %LONG 0x02030802
D.S A:0x0010001c %LE %LONG 0x080b0202
D.S A:0x00100020 %LE %LONG 0x02020302
D.S A:0x00100024 %LE %LONG 0x0336b003
D.S A:0x00100028 %LE %LONG 0x01000003
D.S A:0x0010002c %LE %LONG 0x06030301
D.S A:0x00100030 %LE %LONG 0x000000c8
D.S A:0x00100034 %LE %LONG 0x00500a02
D.S A:0x00100038 %LE %LONG 0x00000404
D.S A:0x0010003c %LE %LONG 0x00280100
D.S A:0x00100040 %LE %LONG 0x00050612
D.S A:0x00100044 %LE %LONG 0x00000000
D.S A:0x00100048 %LE %LONG 0x002a00c8
D.S A:0x0010004c %LE %LONG 0x01000000
D.S A:0x00100050 %LE %LONG 0x00000000
D.S A:0x00100054 %LE %LONG 0x00000000
D.S A:0x00100058 %LE %LONG 0x00000000
D.S A:0x0010005c %LE %LONG 0x00000303
D.S A:0x00100060 %LE %LONG 0x00000000
D.S A:0x00100064 %LE %LONG 0x00000000
D.S A:0x00100068 %LE %LONG 0x00000000
D.S A:0x0010006c %LE %LONG 0x00440442
D.S A:0x00100070 %LE %LONG 0x00000000
D.S A:0x00100074 %LE %LONG 0x00000000
D.S A:0x00100078 %LE %LONG 0x00044200
D.S A:0x0010007c %LE %LONG 0x00000004
D.S A:0x00100080 %LE %LONG 0x00000000
D.S A:0x00100084 %LE %LONG 0x00000000
D.S A:0x00100088 %LE %LONG 0x01000200
D.S A:0x0010008c %LE %LONG 0x40000040
D.S A:0x00100090 %LE %LONG 0x00000002
D.S A:0x00100094 %LE %LONG 0x01010100
D.S A:0x00100098 %LE %LONG 0x02020101
D.S A:0x0010009c %LE %LONG 0x00000a0a
D.S A:0x001000a0 %LE %LONG 0x0fff1000
D.S A:0x001000a4 %LE %LONG 0x7f000fff
D.S A:0x001000a8 %LE %LONG 0x0101017f
D.S A:0x001000ac %LE %LONG 0x01010101
D.S A:0x001000b0 %LE %LONG 0x00000300
D.S A:0x001000b4 %LE %LONG 0x01000000
D.S A:0x001000b8 %LE %LONG 0x00000000
D.S A:0x001000bc %LE %LONG 0x00000000
D.S A:0x001000c0 %LE %LONG 0x00000000
D.S A:0x001000c4 %LE %LONG 0x00000000
D.S A:0x001000c8 %LE %LONG 0x00000000
D.S A:0x001000cc %LE %LONG 0x00000000
D.S A:0x001000d0 %LE %LONG 0x02010100
D.S A:0x001000d4 %LE %LONG 0x00000002
D.S A:0x001000d8 %LE %LONG 0x01020100
D.S A:0x001000dc %LE %LONG 0x00020001
D.S A:0x001000e0 %LE %LONG 0x00010100
D.S A:0x001000e4 %LE %LONG 0x0f0f0f00
D.S A:0x001000e8 %LE %LONG 0x0f0f0f0f
D.S A:0x001000ec %LE %LONG 0x04FFFF0f
D.S A:0x001000f0 %LE %LONG 0x04ffFF04
D.S A:0x001000f4 %LE %LONG 0x04FFff04
D.S A:0x001000f8 %LE %LONG 0x04FFFF04
D.S A:0x001000fc %LE %LONG 0x04000104
D.S A:0x00100100 %LE %LONG 0x04000104
D.S A:0x00100104 %LE %LONG 0x04000104
D.S A:0x00100108 %LE %LONG 0x04000104
D.S A:0x0010010c %LE %LONG 0x00000004
D.S A:0x00100110 %LE %LONG 0x00000000
D.S A:0x00100114 %LE %LONG 0x00000000
D.S A:0x00100118 %LE %LONG 0x00000000
D.S A:0x0010011c %LE %LONG 0x00000000
D.S A:0x00100120 %LE %LONG 0x00000000
D.S A:0x00100124 %LE %LONG 0x00000000
D.S A:0x00100128 %LE %LONG 0x00000000
D.S A:0x0010012c %LE %LONG 0x00000000
D.S A:0x00100130 %LE %LONG 0x00000000
D.S A:0x00100134 %LE %LONG 0x07000000
D.S A:0x00100138 %LE %LONG 0x19000119
D.S A:0x0010013c %LE %LONG 0x01190001
D.S A:0x00100140 %LE %LONG 0x00011900
D.S A:0x00100144 %LE %LONG 0x19000119
D.S A:0x00100148 %LE %LONG 0x01190001
D.S A:0x0010014c %LE %LONG 0x00011900
D.S A:0x00100150 %LE %LONG 0x00000001
D.S A:0x00100154 %LE %LONG 0x06020000
D.S A:0x00100158 %LE %LONG 0x00000200
D.S A:0x0010015c %LE %LONG 0x06120612
D.S A:0x00100160 %LE %LONG 0x06120612
D.S A:0x00100164 %LE %LONG 0x06120612
D.S A:0x00100168 %LE %LONG 0x00020304
D.S A:0x0010016c %LE %LONG 0x00000101

; DDR2 200 MHz Denali PHY
D.S A:0x00100200 %LE %LONG 0x00000000
D.S A:0x00100204 %LE %LONG 0x000f1100
D.S A:0x00100208 %LE %LONG 0xf3013a27
D.S A:0x0010020c %LE %LONG 0x26c002c0
D.S A:0x00100210 %LE %LONG 0xf3013a27
D.S A:0x00100214 %LE %LONG 0x26c002c0
D.S A:0x00100218 %LE %LONG 0xf3013a27
D.S A:0x0010021c %LE %LONG 0x26c002c0
D.S A:0x00100220 %LE %LONG 0xf3013a27
D.S A:0x00100224 %LE %LONG 0x26c002c0
D.S A:0x00100228 %LE %LONG 0xf3013a27
D.S A:0x0010022c %LE %LONG 0x26c002c0
D.S A:0x00100230 %LE %LONG 0x00000000
D.S A:0x00100234 %LE %LONG 0x00000004
D.S A:0x00100238 %LE %LONG 0xb00f322b
D.S A:0x0010023c %LE %LONG 0x00101f04
D.S A:0x00100240 %LE %LONG 0xb00f322b
D.S A:0x00100244 %LE %LONG 0x00101f04
D.S A:0x00100248 %LE %LONG 0xb00f322b
D.S A:0x0010024c %LE %LONG 0x00101f04
D.S A:0x00100250 %LE %LONG 0xb00f322b
D.S A:0x00100254 %LE %LONG 0x00101f04
D.S A:0x00100258 %LE %LONG 0xb00f322b
D.S A:0x0010025c %LE %LONG 0x00101f04
D.S A:0x00100260 %LE %LONG 0x00000000
D.S A:0x00100264 %LE %LONG 0x00000000
D.S A:0x00100268 %LE %LONG 0x00000000
D.S A:0x0010026c %LE %LONG 0x00000000
D.S A:0x00100270 %LE %LONG 0x00000000
D.S A:0x00100274 %LE %LONG 0x00000000
D.S A:0x00100278 %LE %LONG 0x00000000
D.S A:0x0010027c %LE %LONG 0x00000000
D.S A:0x00100280 %LE %LONG 0x00000000
D.S A:0x00100284 %LE %LONG 0x00000000
D.S A:0x00100288 %LE %LONG 0x00000000
D.S A:0x0010028c %LE %LONG 0x00000000
D.S A:0x00100290 %LE %LONG 0x00000000
D.S A:0x00100294 %LE %LONG 0x00000000
D.S A:0x00100298 %LE %LONG 0x00000000
