y.sourcepath m:/\
y.delete

; enable DTCM size=64k base=0x00100000
data.set c15:00000019 0x0010001d

data.load.binary m:\css\git_work_area\build\bin\ITCM 0x00000000
data.load.binary m:\css\git_work_area\build\bin\AHB_RAM 0x08200000
data.load.binary m:\css\git_work_area\build\bin\DDR_RAM 0x5ff00000

data.load.elf m:\css\git_work_area\build\css.elf /strippart 3 /nocode

; do mmu and symbol setup for the high-vectors
mmu.on
mmu.tablewalk on
mmu.c 0xffff0000--0xffffffff a:0x00000000--0x0000ffff
y.reloc 0xffff0000 0x00000000--0x0000ffff

b.s panic /onchip
