SYSTEM.RESET
SYSTEM.CPU CORTEXA8
SYSTEM.JTAGCLOCK 10MHz
SYSTEM.OPTION DBGACK ON
SYSTEM.OPTION RESBREAK OFF
SYSTEM.OPTION ENRESET ON
SYSTEM.OPTION TRST ON
SYSTEM.OPTION WAITRESET ON

SYSTEM.CONFIG MEMORYACCESSPORT 0.
SYSTEM.CONFIG DEBUGACCESSPORT  1.

TRONCHIP.set RESET ON
TRONCHIP.set DABORT OFF
TRONCHIP.set PABORT OFF
TRONCHIP.set UNDEF OFF
TRONCHIP.set FIQ OFF
TRONCHIP.set IRQ OFF
TRONCHIP.set SWI OFF

; 0x80000000 - DAPROM table
; 0x80001000 - ETB
; 0x80002000 - Internal CTI to ETB
; 0x80004000 - Trace funnel
; 0x80005000 - ITM
; 0x80007000 - Debug block inside CortexA8 (CortexA8 PSELDBG input)
; 0x80008000 - CortexA8 ETM (CortexA8 PSELETM input)
; 0x80009000 - CortexA8 CTI (CortexA8 PSELCTI input)
; 0x8000c000 - ETM9CS (ETM9CS PSELETM input)
; 0x8000d000 - ARM926 CTI (CSCTI PSELCTI input)

SYSTEM.CONFIG COREBASE   DAP:0x80007000
SYSTEM.CONFIG ETMBASE    DAP:0x80008000
SYSTEM.CONFIG CTIBASE    DAP:0x80009000
SYSTEM.CONFIG ITMBASE    DAP:0x80005000
SYSTEM.CONFIG ETBBASE    DAP:0x80001000
SYSTEM.CONFIG FUNNELBASE DAP:0x80004000

; funnel:
; slave port 0 = CortexA8
; slave port 1 = ETM9CS
SYSTEM.CONFIG ETMFUNNELPORT 0.
SYSTEM.CONFIG ITMFUNNELPORT 2.

SYSTEM.CONFIG CTICONFIG CORTEXV1

B.DELETE /ALL

; Add DMW96 Cortex menues
menu.rp
(
	add
	menu
	(
		popup "DMW96"
		(
			menuitem "CortexA8 registers"
			(
				; Lauterbach install directory
				per.rp C:\t32\PERCORTEXA8.PER
				per.view
			)
			menuitem "DMW96 registers"
			(
				per.rp cortex.per
				per.view
			)
		)
	)
)

; Add Linux awareness
task.config linux
menu.rp linux

; Just in case the SYS.UP fails below...
ON ERROR GOSUB
(
	ENDDO
)
SYSTEM.MODE UP
