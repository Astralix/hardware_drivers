SYSTEM.RESET
SYSTEM.CPU ARM926EJ
SYSTEM.JTAGCLOCK 10MHz
SYSTEM.OPTION DBGACK ON
SYSTEM.OPTION RESBREAK OFF
SYSTEM.OPTION ENRESET ON
SYSTEM.OPTION TRST ON
SYSTEM.OPTION WAITRESET ON

SYSTEM.CONFIG JTAGACCESSPORT  2.
SYSTEM.CONFIG COREJTAGPORT    0.

TRONCHIP.set RESET OFF
TRONCHIP.set DABORT OFF
TRONCHIP.set PABORT OFF
TRONCHIP.set UNDEF OFF
TRONCHIP.set FIQ OFF
TRONCHIP.set IRQ OFF
TRONCHIP.set SWI OFF

; 0x80000000 - DAPROM table
; 0x80001000 - ETB
; 0x80002000 - Internal CTI to ETB
; 0x80004000 - Trace funnel
; 0x80005000 - ITM
; 0x80007000 - Debug block inside CortexA8 (CortexA8 PSELDBG input)
; 0x80008000 - CortexA8 ETM (CortexA8 PSELETM input)
; 0x80009000 - CortexA8 CTI (CortexA8 PSELCTI input)
; 0x8000c000 - ETM9CS (ETM9CS PSELETM input)
; 0x8000d000 - ARM926 CTI (CSCTI PSELCTI input)

SYSTEM.CONFIG ETMBASE    DAP:0x8000c000
SYSTEM.CONFIG CTIBASE    DAP:0x8000d000
SYSTEM.CONFIG ITMBASE    DAP:0x80005000
SYSTEM.CONFIG ETBBASE    DAP:0x80001000
SYSTEM.CONFIG FUNNELBASE DAP:0x80004000

; funnel:
; slave port 0 = CortexA8
; slave port 1 = ETM9CS
SYSTEM.CONFIG ETMFUNNELPORT 1

SYSTEM.CONFIG CTICONFIG ARMV1

; Add DMW96 CSS menues
menu.rp
(
	add
	menu
	(
		popup "DMW96"
		(
			menuitem "CSS registers"
			(
				per.rp css.per
				per.view
			)
		)
	)
)
